## config/west.yml
```yaml
manifest:
  remotes:
    - name: zmkfirmware
      url-base: https://github.com/zmkfirmware
    - name: philipjellison
      url-base: https://github.com/philipjellison
    # - name: cyboard
    #   url-base: https://github.com/Cyboard-DigitalTailor
  projects:
    - name: zmk
      remote: zmkfirmware
      revision: v0.3
      import: app/west.yml
    - name: zmk-pmw3610-driver
      remote: philipjellison
      revision: 0c7c01e1a315f87f745cf5dced1df65553b90057 # own fork: settle window + debug logging
    # - name: zmk-pmw3610-driver
    #   remote: cyboard
    #   revision: startup_optimization
  self:
    path: config
```
